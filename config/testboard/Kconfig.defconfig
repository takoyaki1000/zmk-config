## config/testboard/Kconfig.defconfig
```kconfig
if SHIELD_TESTBOARD

config ZMK_KEYBOARD_NAME
    default "testboard"

endif # SHIELD_TESTBOARD
```

## drivers/sensor/pmw3320/Kconfig
```kconfig
# drivers/sensor/pmw3320/Kconfig
config PMW3320
    bool "PMW3320 optical mouse sensor"
    default n
    depends on SPI
    help
      Enable driver for PMW3320 sensor.
```
